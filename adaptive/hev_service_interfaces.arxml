AUTOSAR XML (schema 00049)
package /HEVServiceInterfaces
  6 x service interface, all with major-version=1, minor-version=0:
    PowertrainStatus
      namespaces:
        symbol props hev
        symbol props zonal
      events:
        6 x data:
          ECM_EngStsEvent: type=ECM_EngStsEventType
          ECM_EngThmEvent: type=ECM_EngThmEventType
          PCU_MgStsEvent: type=PCU_MgStsEventType
          PCU_MgThmEvent: type=PCU_MgThmEventType
          DCDC_StsEvent: type=DCDC_StsEventType
          TMS_StsEvent: type=TMS_StsEventType
    ChassisStatus
      namespaces:
        symbol props hev
        symbol props zonal
      events:
        4 x data:
          ESC_VehDynEvent: type=ESC_VehDynEventType
          ESC_WhlSpdEvent: type=ESC_WhlSpdEventType
          ESC_BrkEvent: type=ESC_BrkEventType
          EPS_StsEvent: type=EPS_StsEventType
    EnergyStorageStatus
      namespaces:
        symbol props hev
        symbol props zonal
      events:
        data BMS_PackStsEvent: type=BMS_PackStsEventType
        data BMS_ThmEvent: type=BMS_ThmEventType
    BodyChassisStatus
      namespaces:
        symbol props hev
        symbol props zonal
      events:
        4 x data:
          SCU_TravelEvent: type=SCU_TravelEventType
          SCU_BodyAccEvent: type=SCU_BodyAccEventType
          TPMS_PressEvent: type=TPMS_PressEventType
          CCU_StsEvent: type=CCU_StsEventType
    DriverInput
      namespaces:
        symbol props hev
        symbol props zonal
      events:
        data PedalEvent: type=PedalEventType
    EnergyManagement
      namespaces:
        symbol props hev
        symbol props zonal
      events:
        5 x data:
          EngineRequest: type=EngineRequestType
          MotorRequest: type=MotorRequestType
          ThermalRequest: type=ThermalRequestType
          BatteryRequest: type=BatteryRequestType
          ClimateRequest: type=ClimateRequestType
