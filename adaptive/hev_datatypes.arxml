AUTOSAR XML (schema 00049)
package /HEVTypes
  22 x std cpp implementation data type, all with category=STRUCTURE, type-emitter=TYPE_EMITTER_ARA:
    ECM_EngStsEventType
      namespaces:
        symbol props hev
        symbol props zonal
      cpp implementation data type element n_eng: type-reference=float
      cpp implementation data type element tq_eng: type-reference=float
      cpp implementation data type element fuel_rate: type-reference=float
    ECM_EngThmEventType
      namespaces:
        symbol props hev
        symbol props zonal
      cpp implementation data type element T_cool_eng: type-reference=float
      cpp implementation data type element T_cat: type-reference=float
    PCU_MgStsEventType
      namespaces:
        symbol props hev
        symbol props zonal
      4 x cpp implementation data type element, all with type-reference=float:
        n_MG1
        tq_MG1
        n_MG2
        tq_MG2
    PCU_MgThmEventType
      namespaces:
        symbol props hev
        symbol props zonal
      cpp implementation data type element T_MG1: type-reference=float
      cpp implementation data type element T_MG2: type-reference=float
      cpp implementation data type element T_inv: type-reference=float
    DCDC_StsEventType
      namespaces:
        symbol props hev
        symbol props zonal
      cpp implementation data type element V_12: type-reference=float
      cpp implementation data type element I_dcdc: type-reference=float
    TMS_StsEventType
      namespaces:
        symbol props hev
        symbol props zonal
      cpp implementation data type element T_cool_edu: type-reference=float
      cpp implementation data type element T_rad_out: type-reference=float
    ESC_VehDynEventType
      namespaces:
        symbol props hev
        symbol props zonal
      4 x cpp implementation data type element, all with type-reference=float:
        v_veh
        a_long
        a_lat
        yaw_rate
    ESC_WhlSpdEventType
      namespaces:
        symbol props hev
        symbol props zonal
      4 x cpp implementation data type element, all with type-reference=float:
        w_FL
        w_FR
        w_RL
        w_RR
    ESC_BrkEventType
      namespaces:
        symbol props hev
        symbol props zonal
      cpp implementation data type element brake_pressure: type-reference=float
      cpp implementation data type element T_brake_F: type-reference=float
      cpp implementation data type element T_brake_R: type-reference=float
    EPS_StsEventType
      namespaces:
        symbol props hev
        symbol props zonal
      cpp implementation data type element steer_angle: type-reference=float
    BMS_PackStsEventType
      namespaces:
        symbol props hev
        symbol props zonal
      cpp implementation data type element I_batt: type-reference=float
      cpp implementation data type element V_batt: type-reference=float
      cpp implementation data type element SOC: type-reference=float
    BMS_ThmEventType
      namespaces:
        symbol props hev
        symbol props zonal
      cpp implementation data type element T_batt: type-reference=float
    SCU_TravelEventType
      namespaces:
        symbol props hev
        symbol props zonal
      4 x cpp implementation data type element, all with type-reference=float:
        susp_travel_FL
        susp_travel_FR
        susp_travel_RL
        susp_travel_RR
    SCU_BodyAccEventType
      namespaces:
        symbol props hev
        symbol props zonal
      4 x cpp implementation data type element, all with type-reference=float:
        body_acc_FL
        body_acc_FR
        body_acc_RL
        body_acc_RR
    TPMS_PressEventType
      namespaces:
        symbol props hev
        symbol props zonal
      4 x cpp implementation data type element, all with type-reference=float:
        p_tire_FL
        p_tire_FR
        p_tire_RL
        p_tire_RR
    CCU_StsEventType
      namespaces:
        symbol props hev
        symbol props zonal
      cpp implementation data type element T_cabin: type-reference=float
      cpp implementation data type element P_ac: type-reference=float
    PedalEventType
      namespaces:
        symbol props hev
        symbol props zonal
      cpp implementation data type element pedal_acc: type-reference=float
    EngineRequestType
      namespaces:
        symbol props hev
        symbol props zonal
      cpp implementation data type element tq_eng_req: type-reference=float
      cpp implementation data type element n_eng_req: type-reference=float
      cpp implementation data type element engine_on_req: type-reference=float
    MotorRequestType
      namespaces:
        symbol props hev
        symbol props zonal
      cpp implementation data type element tq_MG1_req: type-reference=float
      cpp implementation data type element tq_MG2_req: type-reference=float
    ThermalRequestType
      namespaces:
        symbol props hev
        symbol props zonal
      cpp implementation data type element edu_pump_duty: type-reference=float
      cpp implementation data type element fan_duty: type-reference=float
      cpp implementation data type element heater_valve: type-reference=float
    BatteryRequestType
      namespaces:
        symbol props hev
        symbol props zonal
      cpp implementation data type element P_dis_limit: type-reference=float
      cpp implementation data type element P_chg_limit: type-reference=float
    ClimateRequestType
      namespaces:
        symbol props hev
        symbol props zonal
      cpp implementation data type element T_set: type-reference=float
      cpp implementation data type element Q_req: type-reference=float
