AUTOSAR XML (schema 00049)
package /SomeipInstancesHEV
  6 x provided someip service instance, all with service-instance-id=1:
    P_ZC_FRONT_PowertrainStatus: service-interface-deployment=PowertrainStatus
      someip provided event group PEG1: event-group=Eventgroup1, multicast-threshold=2
    P_ZC_FRONT_ChassisStatus: service-interface-deployment=ChassisStatus
      someip provided event group PEG1: event-group=Eventgroup1, multicast-threshold=2
    P_ZC_REAR_EnergyStorageStatus: service-interface-deployment=EnergyStorageStatus
      someip provided event group PEG1: event-group=Eventgroup1, multicast-threshold=2
    P_ZC_REAR_BodyChassisStatus: service-interface-deployment=BodyChassisStatus
      someip provided event group PEG1: event-group=Eventgroup1, multicast-threshold=2
    P_ZC_FRONT_DriverInput: service-interface-deployment=DriverInput
      someip provided event group PEG1: event-group=Eventgroup1, multicast-threshold=2
    P_CVC_EnergyManagement: service-interface-deployment=EnergyManagement
      someip provided event group PEG1: event-group=Eventgroup1, multicast-threshold=2
  12 x required someip service instance, all with required-minor-version=0, required-service-instance-id=1, version-driven-find-behavior=MINIMUM-MINOR-VERSION:
    R_CVC_PowertrainStatus: service-interface-deployment=PowertrainStatus
      someip required event group REG1: event-group=Eventgroup1
    R_CVC_ChassisStatus: service-interface-deployment=ChassisStatus
      someip required event group REG1: event-group=Eventgroup1
    R_CVC_EnergyStorageStatus: service-interface-deployment=EnergyStorageStatus
      someip required event group REG1: event-group=Eventgroup1
    R_CVC_BodyChassisStatus: service-interface-deployment=BodyChassisStatus
      someip required event group REG1: event-group=Eventgroup1
    R_CVC_DriverInput: service-interface-deployment=DriverInput
      someip required event group REG1: event-group=Eventgroup1
    R_TCU_PowertrainStatus: service-interface-deployment=PowertrainStatus
      someip required event group REG1: event-group=Eventgroup1
    R_TCU_ChassisStatus: service-interface-deployment=ChassisStatus
      someip required event group REG1: event-group=Eventgroup1
    R_TCU_EnergyStorageStatus: service-interface-deployment=EnergyStorageStatus
      someip required event group REG1: event-group=Eventgroup1
    R_TCU_BodyChassisStatus: service-interface-deployment=BodyChassisStatus
      someip required event group REG1: event-group=Eventgroup1
    R_TCU_DriverInput: service-interface-deployment=DriverInput
      someip required event group REG1: event-group=Eventgroup1
    R_ZC_FRONT_EnergyManagement: service-interface-deployment=EnergyManagement
      someip required event group REG1: event-group=Eventgroup1
    R_ZC_REAR_EnergyManagement: service-interface-deployment=EnergyManagement
      someip required event group REG1: event-group=Eventgroup1
