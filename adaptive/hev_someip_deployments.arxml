AUTOSAR XML (schema 00049)
package /SomeipDeploymentsHEV
  6 x someip service interface deployment, all with service-interface-version={major-version=1, minor-version=0}:
    PowertrainStatus: service-interface=PowertrainStatus, service-interface-id=4353
      6 x someip event deployment, all with transport-protocol=UDP:
        ECM_EngStsEvent: event=ECM_EngStsEvent, event-id=0x0001
        ECM_EngThmEvent: event=ECM_EngThmEvent, event-id=0x0002
        PCU_MgStsEvent: event=PCU_MgStsEvent, event-id=0x0003
        PCU_MgThmEvent: event=PCU_MgThmEvent, event-id=0x0004
        DCDC_StsEvent: event=DCDC_StsEvent, event-id=0x0005
        TMS_StsEvent: event=TMS_StsEvent, event-id=0x0006
      someip event group Eventgroup1: event-group-id=1, event=[ECM_EngStsEvent, ECM_EngThmEvent, PCU_MgStsEvent, PCU_MgThmEvent, DCDC_StsEvent, TMS_StsEvent]
    ChassisStatus: service-interface=ChassisStatus, service-interface-id=4354
      4 x someip event deployment, all with transport-protocol=UDP:
        ESC_VehDynEvent: event=ESC_VehDynEvent, event-id=0x0001
        ESC_WhlSpdEvent: event=ESC_WhlSpdEvent, event-id=0x0002
        ESC_BrkEvent: event=ESC_BrkEvent, event-id=0x0003
        EPS_StsEvent: event=EPS_StsEvent, event-id=0x0004
      someip event group Eventgroup1: event-group-id=1, event=[ESC_VehDynEvent, ESC_WhlSpdEvent, ESC_BrkEvent, EPS_StsEvent]
    EnergyStorageStatus: service-interface=EnergyStorageStatus, service-interface-id=4609
      someip event deployment BMS_PackStsEvent: event=BMS_PackStsEvent, event-id=0x0001, transport-protocol=UDP
      someip event deployment BMS_ThmEvent: event=BMS_ThmEvent, event-id=0x0002, transport-protocol=UDP
      someip event group Eventgroup1: event-group-id=1, event=[BMS_PackStsEvent, BMS_ThmEvent]
    BodyChassisStatus: service-interface=BodyChassisStatus, service-interface-id=4610
      4 x someip event deployment, all with transport-protocol=UDP:
        SCU_TravelEvent: event=SCU_TravelEvent, event-id=0x0001
        SCU_BodyAccEvent: event=SCU_BodyAccEvent, event-id=0x0002
        TPMS_PressEvent: event=TPMS_PressEvent, event-id=0x0003
        CCU_StsEvent: event=CCU_StsEvent, event-id=0x0004
      someip event group Eventgroup1: event-group-id=1, event=[SCU_TravelEvent, SCU_BodyAccEvent, TPMS_PressEvent, CCU_StsEvent]
    DriverInput: service-interface=DriverInput, service-interface-id=4355
      someip event deployment PedalEvent: event=PedalEvent, event-id=0x0001, transport-protocol=UDP
      someip event group Eventgroup1: event-group-id=1, event=PedalEvent
    EnergyManagement: service-interface=EnergyManagement, service-interface-id=8193
      5 x someip event deployment, all with transport-protocol=UDP:
        EngineRequest: event=EngineRequest, event-id=0x0001
        MotorRequest: event=MotorRequest, event-id=0x0002
        ThermalRequest: event=ThermalRequest, event-id=0x0003
        BatteryRequest: event=BatteryRequest, event-id=0x0004
        ClimateRequest: event=ClimateRequest, event-id=0x0005
      someip event group Eventgroup1: event-group-id=1, event=[EngineRequest, MotorRequest, ThermalRequest, BatteryRequest, ClimateRequest]
